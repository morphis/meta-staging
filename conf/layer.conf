## conf/layer.conf
```bitbake
# We have a conf and classes directory, append to BBPATH
BBPATH .= ":${LAYERDIR}"

# We have a recipes directory, add to BBFILES
BBFILES += "${LAYERDIR}/recipes*/*/*.bb ${LAYERDIR}/recipes*/*/*.bbappend"

BBFILE_COLLECTIONS += "staging-layer"
BBFILE_PATTERN_staging-layer := "^${LAYERDIR}/"
BBFILE_PRIORITY_staging-layer = "8"
```
